## CMakeLists.txt
```
cmake_minimum_required(VERSION 3.20.0)
find_package(Zephyr REQUIRED HINTS $ENV{ZEPHYR_BASE})

project(BLE_pansement)

# CMakeLists.txt
target_sources(app PRIVATE 
    src/main.c 
    src/my_service.c 
    src/my_central.c
)
```

## prj.conf
```kconfig
CONFIG_GPIO=y
CONFIG_ADC=y
CONFIG_LOG=y
CONFIG_BT=y
CONFIG_BT_PERIPHERAL=y
CONFIG_BT_CENTRAL=y
CONFIG_BT_DEVICE_NAME="Pansement"
CONFIG_BT_MAX_CONN=2
CONFIG_BT_SCAN=y
CONFIG_BT_SCAN_FILTER_ENABLE=y
CONFIG_BT_SCAN_UUID_CNT=1
CONFIG_BT_GATT_CLIENT=y
CONFIG_BT_GATT_DM=y
CONFIG_HEAP_MEM_POOL_SIZE=4096
CONFIG_BT_SMP=y
CONFIG_BT_SIGNING=y
CONFIG_NORDIC_SECURITY_BACKEND=y
CONFIG_MBEDTLS=y
CONFIG_BT_SMP=y
CONFIG_JSON_LIBRARY=y

# --- Modifications pour augmenter le MTU ---

# 1. Augmenter la taille physique des buffers (Matériel)
# Permet de stocker des paquets de 251 octets en mémoire
CONFIG_BT_BUF_ACL_TX_SIZE=251
CONFIG_BT_BUF_ACL_RX_SIZE=251

# 2. Augmenter la taille logique du paquet (Logiciel/L2CAP)
# C'est la valeur max que l'application a le droit d'utiliser (247 octets)
CONFIG_BT_L2CAP_TX_MTU=247
CONFIG_BT_L2CAP_DYNAMIC_CHANNEL=y

# 3. Activer l'extension de longueur de données (Data Length Extension - DLE)
# Indispensable pour que le contrôleur accepte physiquement d'envoyer plus
CONFIG_BT_CTLR_DATA_LENGTH_MAX=251
CONFIG_BT_USER_DATA_LEN_UPDATE=y
```

## app.overlay
```dts
/* Fichier : app.overlay */

/* 1. Les Dictionnaires indispensables (Includes) */
#include <zephyr/dt-bindings/adc/adc.h>      /* Pour ADC_GAIN_1_6, etc. */
#include <zephyr/dt-bindings/adc/nrf-adc.h>  /* Pour NRF_SAADC_AIN0 ! C'est lui qui manquait */

/ {
	zephyr,user {
		io-channels = <&adc 0>;
	};
};

&adc {
	status = "okay";
	#address-cells = <1>;
	#size-cells = <0>;

	channel@0 {
		reg = <0>; 
		zephyr,gain = "ADC_GAIN_1_6";
		zephyr,reference = "ADC_REF_INTERNAL";
		zephyr,acquisition-time = <ADC_ACQ_TIME_DEFAULT>;
		/* Note : On a retiré la résolution ici, on la définit dans le main.c */
		
		compatible = "zephyr,adc-channel";
		zephyr,input-positive = <NRF_SAADC_AIN0>; 
	};
};
```

## src/main.c
```c
// #include <zephyr/kernel.h>
// #include <zephyr/drivers/adc.h>
// #include <zephyr/logging/log.h>
// #include <zephyr/bluetooth/bluetooth.h>
// #include <zephyr/bluetooth/uuid.h>
// #include <zephyr/bluetooth/gatt.h>
// #include <bluetooth/scan.h>
// #include <zephyr/data/json.h> // <--- L'INCLUDE OFFICIEL
// #include "my_service.h"
// #include "my_central.h"

// LOG_MODULE_REGISTER(main_app);

// /* ================= CONFIGURATION MANUELLE ADC ================= */

// #define ADC_NODE DT_NODELABEL(adc)
// static const struct device *adc_dev = DEVICE_DT_GET(ADC_NODE);
// int16_t sample_buffer[1];
// struct adc_sequence sequence = {
//     .buffer = sample_buffer,
//     .buffer_size = sizeof(sample_buffer),
//     .resolution = 12,
//     .oversampling = 0,
//     .calibrate = 0,
// };
// static struct adc_channel_cfg channel_0_cfg = {
//     .gain = ADC_GAIN_1_6, .reference = ADC_REF_INTERNAL, .acquisition_time = ADC_ACQ_TIME_DEFAULT, .channel_id = 0,
// };

// /* ================= CONFIGURATION BLE (Advertising) ================= */
// static const struct bt_data ad[] = {
//     BT_DATA_BYTES(BT_DATA_FLAGS, (BT_LE_AD_GENERAL | BT_LE_AD_NO_BREDR)),
//     BT_DATA_BYTES(BT_DATA_UUID128_ALL, MY_SERVICE_UUID),
// };
// static const struct bt_data sd[] = {
//     BT_DATA(BT_DATA_NAME_COMPLETE, CONFIG_BT_DEVICE_NAME, sizeof(CONFIG_BT_DEVICE_NAME) - 1),
// };

// static void bt_ready_cb(int err) {
//     if (err) { LOG_ERR("Bluetooth init failed (err %d)", err); return; }

//     // 1. Périphérique (Advertise)
//     err = bt_le_adv_start(BT_LE_ADV_CONN, ad, ARRAY_SIZE(ad), sd, ARRAY_SIZE(sd));
//     if (err) { LOG_ERR("Advertising failed (err %d)", err); }
//     else { LOG_INF("Advertising started!"); }

//     // 2. Central (Scan)
//     scan_init();
//     err = bt_scan_start(BT_SCAN_TYPE_SCAN_PASSIVE);
//     if (err) { LOG_ERR("Impossible de scanner (err %d)", err); }
//     else { LOG_INF("Scanner démarré !"); }
// }
// /* === 1. Définition de la structure de données === */
// struct my_data_t {
//     int adc_val;
//     const char *status; // Exemple pour montrer qu'on peut ajouter du texte
// };

// /* === 2. Mapping pour la librairie JSON Zephyr === */
// static const struct json_obj_descr my_data_descr[] = {
//     // On associe la variable C 'adc_val' à la clé JSON "adc"
//     JSON_OBJ_DESCR_PRIM(struct my_data_t, adc_val, JSON_TOK_NUMBER),
//     // On associe la variable C 'status' à la clé JSON "msg"
//     JSON_OBJ_DESCR_PRIM(struct my_data_t, status, JSON_TOK_STRING),
// };

// /* ================= MAIN LOOP ================= */
// int main(void) {
//     int err;
//     // Buffer pour stocker la chaîne JSON finale
//     char json_buffer[100];
//     struct my_data_t data_to_send;

//     /* Init ADC */
//     if (!device_is_ready(adc_dev)) return 0;
//     adc_channel_setup(adc_dev, &channel_0_cfg);
//     sequence.channels = BIT(0);

//     /* Init BLE (qui lancera l'adv et le scan dans le callback) */
//     err = bt_enable(bt_ready_cb);
//     if (err) return 0;

//     /* Boucle */
//     while (1) {
//         err = adc_read(adc_dev, &sequence);
//         if (err == 0) {
//             int32_t raw_value = sample_buffer[0];
//             // 1. Remplissage de la structure C
//             data_to_send.adc_val = raw_value;
//             data_to_send.status = "OK"; // Juste pour l'exemple

//             // 2. Encodage : Struct C -> Chaîne JSON
//             // json_obj_encode_buf(descr, count, data, buffer, size)
//             int ret = json_obj_encode_buf(my_data_descr,
//                                           ARRAY_SIZE(my_data_descr),
//                                           &data_to_send,
//                                           json_buffer,
//                                           sizeof(json_buffer));
//             if (ret == 0) {
//                 LOG_INF("JSON généré : %s", json_buffer);
//                 // 3. Envoi via BLE (on envoie strlen(json_buffer))
//                 my_service_send_json(json_buffer, strlen(json_buffer));

//             //my_service_send_adc_value((uint16_t)raw_value);
//         } else {
//                 LOG_ERR("Erreur encodage JSON : %d", ret);
//             }

//         }
//     k_sleep(K_SECONDS(1));
//     }
//     return 0;
// }

#include <zephyr/kernel.h>
#include <zephyr/drivers/adc.h>
#include <zephyr/logging/log.h>
#include <zephyr/bluetooth/bluetooth.h>
#include <zephyr/bluetooth/uuid.h>
#include <zephyr/bluetooth/gatt.h>
#include <zephyr/bluetooth/conn.h> // Utile pour les connexions
#include <bluetooth/scan.h>
#include <zephyr/data/json.h> // <--- L'INCLUDE OFFICIEL

#include "my_service.h"
#include "my_central.h"

LOG_MODULE_REGISTER(main_app);

/* ================= CONFIGURATION MANUELLE ADC ================= */

#define ADC_NODE DT_NODELABEL(adc)
static const struct device *adc_dev = DEVICE_DT_GET(ADC_NODE);
int16_t sample_buffer[1];
struct adc_sequence sequence = {
    .buffer = sample_buffer,
    .buffer_size = sizeof(sample_buffer),
    .resolution = 12,
    .oversampling = 0,
    .calibrate = 0,
};
static struct adc_channel_cfg channel_0_cfg = {
    .gain = ADC_GAIN_1_6,
    .reference = ADC_REF_INTERNAL,
    .acquisition_time = ADC_ACQ_TIME_DEFAULT,
    .channel_id = 0,
};

/* ================= GESTION DU MTU (Nouveau code ajouté ici) ================= */

/* 1. Callback appelé une fois que l'échange MTU est terminé */
static void exchange_func(struct bt_conn *conn, uint8_t att_err,
                          struct bt_gatt_exchange_params *params)
{
    if (!att_err)
    {
        LOG_INF("MTU mis a jour ! Nouvelle taille : %d", bt_gatt_get_mtu(conn));
    }
    else
    {
        LOG_ERR("Echec negociation MTU : %d", att_err);
    }
}

static struct bt_gatt_exchange_params exchange_params = {
    .func = exchange_func,
};

/* 2. Callbacks de connexion / déconnexion */
static void connected(struct bt_conn *conn, uint8_t err)
{
    if (err)
    {
        LOG_ERR("Erreur de connexion (err %u)", err);
        return;
    }
    LOG_INF("Connecte !");

    // Lancement de la négociation MTU pour supporter les gros JSON
    int ret = bt_gatt_exchange_mtu(conn, &exchange_params);
    if (ret)
    {
        LOG_ERR("Impossible de lancer l'echange MTU (err %d)", ret);
    }
}

static void disconnected(struct bt_conn *conn, uint8_t reason)
{
    LOG_INF("Deconnecte (reason 0x%02x)", reason);
}

/* Enregistrement des callbacks de connexion */
BT_CONN_CB_DEFINE(conn_callbacks) = {
    .connected = connected,
    .disconnected = disconnected,
};

/* ================= CONFIGURATION BLE (Advertising) ================= */
static const struct bt_data ad[] = {
    BT_DATA_BYTES(BT_DATA_FLAGS, (BT_LE_AD_GENERAL | BT_LE_AD_NO_BREDR)),
    BT_DATA_BYTES(BT_DATA_UUID128_ALL, MY_SERVICE_UUID),
};
static const struct bt_data sd[] = {
    BT_DATA(BT_DATA_NAME_COMPLETE, CONFIG_BT_DEVICE_NAME, sizeof(CONFIG_BT_DEVICE_NAME) - 1),
};

static void bt_ready_cb(int err)
{
    if (err)
    {
        LOG_ERR("Bluetooth init failed (err %d)", err);
        return;
    }

    // 1. Périphérique (Advertise)
    err = bt_le_adv_start(BT_LE_ADV_CONN, ad, ARRAY_SIZE(ad), sd, ARRAY_SIZE(sd));
    if (err)
    {
        LOG_ERR("Advertising failed (err %d)", err);
    }
    else
    {
        LOG_INF("Advertising started!");
    }

    // 2. Central (Scan)
    scan_init();
    err = bt_scan_start(BT_SCAN_TYPE_SCAN_PASSIVE);
    if (err)
    {
        LOG_ERR("Impossible de scanner (err %d)", err);
    }
    else
    {
        LOG_INF("Scanner démarré !");
    }
}

/* === 1. Définition de la structure de données === */
struct my_data_t
{
    int adc_val;
    const char *status;
};

/* === 2. Mapping pour la librairie JSON Zephyr === */
static const struct json_obj_descr my_data_descr[] = {
    JSON_OBJ_DESCR_PRIM(struct my_data_t, adc_val, JSON_TOK_NUMBER),
    JSON_OBJ_DESCR_PRIM(struct my_data_t, status, JSON_TOK_STRING),
};

/* ================= MAIN LOOP ================= */
int main(void)
{
    int err;
    char json_buffer[128]; // J'ai augmenté un peu la taille par sécurité (100 -> 128)
    struct my_data_t data_to_send;

    /* Init ADC */
    if (!device_is_ready(adc_dev))
        return 0;
    adc_channel_setup(adc_dev, &channel_0_cfg);
    sequence.channels = BIT(0);

    /* Init BLE */
    err = bt_enable(bt_ready_cb);
    if (err)
        return 0;

    /* Boucle */
    while (1)
    {
        err = adc_read(adc_dev, &sequence);
        if (err == 0)
        {
            int32_t raw_value = sample_buffer[0];

            // 1. Remplissage
            data_to_send.adc_val = raw_value;
            data_to_send.status = "OK";

            memset(json_buffer, 0, sizeof(json_buffer));

            // 2. Encodage JSON
            int ret = json_obj_encode_buf(my_data_descr,
                                          ARRAY_SIZE(my_data_descr),
                                          &data_to_send,
                                          json_buffer,
                                          sizeof(json_buffer));
            if (ret == 0)
            {
                LOG_INF("JSON genere : %s", json_buffer);
                // 3. Envoi via BLE
                my_service_send_json(json_buffer, strlen(json_buffer));
            }
            else
            {
                LOG_ERR("Erreur encodage JSON : %d", ret);
            }
        }

        // Pause d'une seconde (en dehors du IF pour éviter le blocage)
        k_sleep(K_SECONDS(1));
    }
    return 0;
}
```

## src/my_central.c
```c
#include <bluetooth/scan.h> // La librairie facile de Nordic
#include <zephyr/kernel.h>
#include <zephyr/logging/log.h>
#include <bluetooth/scan.h> 
#include "my_central.h"
#include "my_service.h"
#include <bluetooth/gatt_dm.h> // Le Discovery Manager


LOG_MODULE_REGISTER(central);
/* L'UUID du capteur que l'on cherche.
   Pour l'exercice, disons qu'on cherche un autre appareil qui a le MÊME service que nous.
   (Ou un UUID standard comme Heart Rate si tu as un capteur cardiaque) */
#define REMOTE_SERVICE_UUID  MY_TARGET_UUID


static struct bt_uuid_128 service_uuid_target = BT_UUID_INIT_128(MY_TARGET_UUID);

// Variable globale pour stocker le pointeur vers la connexion du capteur
static struct bt_conn *conn_to_sensor = NULL; 

static void scan_filter_match(struct bt_scan_device_info *device_info,
                              struct bt_scan_filter_match *filter_match,
                              bool connectable)
{
    char addr[BT_ADDR_LE_STR_LEN];
    struct bt_conn *conn; // <--- 1. On crée une variable temporaire
    int err;

    if (conn_to_sensor) {
        return; 
    }

    bt_addr_le_to_str(device_info->recv_info->addr, addr, sizeof(addr));
    LOG_INF("CIBLE TROUVÉE ! Tentative de connexion à %s", addr);

    bt_scan_stop();
    
    // 2. LANCER la connexion (Avec le 4ème argument !)
    err = bt_conn_le_create(
        device_info->recv_info->addr,
        BT_CONN_LE_CREATE_CONN,
        BT_LE_CONN_PARAM_DEFAULT,
        &conn // <--- C'est LUI qui manquait ! Le pointeur pour récupérer la connexion.
    );

    if (err) {
        LOG_ERR("Erreur creation connexion (err %d). Relance scan.", err);
        bt_scan_start(BT_SCAN_TYPE_SCAN_PASSIVE); 
    } else {
        // Si la création a réussi, on libère notre référence locale.
        // Pourquoi ? Parce que la connexion "officielle" sera gérée et stockée 
        // dans la fonction callback 'connected' que nous avons définie plus bas.
        // Si on ne fait pas ça, on garde une référence inutile en mémoire.
        bt_conn_unref(conn);
    }
}

/* On enregistre nos fonctions de rappel */
BT_SCAN_CB_INIT(scan_cb, scan_filter_match, NULL, NULL, NULL);

void scan_init(void) // Pas de static ici !
{
    int err;

    struct bt_le_scan_param scan_param = {
        .type       = BT_LE_SCAN_TYPE_PASSIVE,
        .options    = BT_LE_SCAN_OPT_NONE,
        .interval   = BT_GAP_SCAN_FAST_INTERVAL,
        .window     = BT_GAP_SCAN_FAST_WINDOW,
    };

    struct bt_scan_init_param scan_init = {
        .connect_if_match = 0, // On met 0 pour l'instant (mode manuel)
        .scan_param = &scan_param,
        .conn_param = BT_LE_CONN_PARAM_DEFAULT
    };

    bt_scan_init(&scan_init);
    bt_scan_cb_register(&scan_cb);

    /* Ajout du filtre UUID */
    /* Attention : on caste le pointeur en (struct bt_uuid*) pour que la fonction l'accepte */
    err = bt_scan_filter_add(BT_SCAN_FILTER_TYPE_UUID, (struct bt_uuid *)&service_uuid_target);
    if (err) {
        LOG_ERR("Erreur ajout filtre (err %d)", err);
        return;
    }

    err = bt_scan_filter_enable(BT_SCAN_UUID_FILTER, false);
    if (err) {
        LOG_ERR("Erreur activation filtre (err %d)", err);
    }
    
    LOG_INF("Scanner initialisé.");
}


/* --- Callbacks du Discovery Manager --- */

/* Appelé quand la découverte est terminée avec succès */
static void discovery_completed(struct bt_gatt_dm *dm, void *context)
{
    LOG_INF("Service découvert avec succès !");
    
    /* C'est ICI qu'on va chercher notre caractéristique spécifique 
       et s'abonner (on le fera à l'étape suivante).
       Pour l'instant, on veut juste voir ce message. */

    /* IMPORTANT : Il faut toujours libérer la mémoire du DM à la fin */
    bt_gatt_dm_data_release(dm);
}

/* Appelé si le service n'est pas trouvé */
static void discovery_service_not_found(struct bt_conn *conn, void *context)
{
    LOG_WRN("Service non trouvé sur cet appareil.");
}

/* Appelé s'il y a une erreur technique */
static void discovery_error(struct bt_conn *conn, int err, void *context)
{
    LOG_ERR("Erreur lors de la découverte (err %d)", err);
}

/* Structure qui regroupe nos callbacks */
static struct bt_gatt_dm_cb discovery_cb = {
    .completed = discovery_completed,
    .service_not_found = discovery_service_not_found,
    .error_found = discovery_error,
};



/* Fonctions de rappel du lien (S'exécutent lors de la connexion/déconnexion) */

void connected(struct bt_conn *conn, uint8_t err)
{
    char addr[BT_ADDR_LE_STR_LEN];
    bt_addr_le_to_str(bt_conn_get_dst(conn), addr, sizeof(addr));

    if (err) {
        LOG_ERR("Connexion échouée à %s (err %d)", addr, err);
        return;
    }

    LOG_INF("Connexion établie avec succès avec %s", addr);

    // Stocker la connexion et arrêter le scan pour économiser la batterie
    conn_to_sensor = bt_conn_ref(conn); // Conserve la référence
    bt_le_scan_stop(); // On arrête le scan une fois qu'on a notre cible !

    /* Prochaine étape : Lancer le service discovery (GATT) */
        /* --- LE NOUVEAU CODE COMMENCE ICI --- */
    
    /* On lance la découverte UNIQUEMENT pour le service qu'on cherche (Remote UUID) */
    /* Le NULL à la fin est le contexte (pas utilisé ici) */
    err = bt_gatt_dm_start(conn, (struct bt_uuid *)&service_uuid_target, &discovery_cb, NULL);
    
    if (err) {
        LOG_ERR("Impossible de lancer la découverte (err %d)", err);
    } else {
        LOG_INF("Lancement de la découverte des services...");
    }
}

void disconnected(struct bt_conn *conn, uint8_t reason)
{
    char addr[BT_ADDR_LE_STR_LEN];
    bt_addr_le_to_str(bt_conn_get_dst(conn), addr, sizeof(addr));

    LOG_INF("Déconnexion de %s (Raison: 0x%02x)", addr, reason);

    // Libérer la référence et relancer le scan pour retrouver le capteur
    if (conn_to_sensor) {
        bt_conn_unref(conn_to_sensor);
        conn_to_sensor = NULL;
    }
    
    // On pourrait relancer le scan ici si la cible est perdue
}

// Macro Zephyr pour enregistrer les callbacks de connexion
BT_CONN_CB_DEFINE(conn_callbacks) = {
    .connected    = connected,
    .disconnected = disconnected,
};
```

## src/my_central.h
```c
#ifndef MY_CENTRAL_H
#define MY_CENTRAL_H

/* Fonction pour initialiser et démarrer le scanner */
void scan_init(void);

#endif
```

## src/my_service.c
```c
// #include <zephyr/bluetooth/bluetooth.h>
// #include <zephyr/bluetooth/gatt.h>
// #include <zephyr/bluetooth/uuid.h>
// #include <zephyr/logging/log.h>
// #include <string.h>
// #include "my_service.h"

// LOG_MODULE_REGISTER(my_service_module);

// static struct bt_uuid_128 service_uuid = BT_UUID_INIT_128(MY_SERVICE_UUID);
// static struct bt_uuid_128 char_uuid = BT_UUID_INIT_128(MY_CHARACTERISTIC_UUID);
// // static uint16_t adc_value_cache = 0;

// /* Cache pour stocker la dernière chaîne JSON envoyée (Max 100 octets pour cet exemple) (on remplace la variable envoyé par le cache)*/
// static char json_payload_cache[100];

// /* Callback appelé quand le téléphone active/désactive les notifications (CCCD) */
// static void my_ccc_cfg_changed(const struct bt_gatt_attr *attr, uint16_t value)
// {
//     LOG_INF("Notifications activées: %d", (value == BT_GATT_CCC_NOTIFY));
// }

// /* DÉFINITION STATIQUE DU SERVICE GATT */
// BT_GATT_SERVICE_DEFINE(my_service,
//                        BT_GATT_PRIMARY_SERVICE(&service_uuid),

//                        /*Caractéristique ADC (Lecture + Notification)*/
//                        BT_GATT_CHARACTERISTIC(&char_uuid.uuid,
//                                               BT_GATT_CHRC_READ | BT_GATT_CHRC_NOTIFY,
//                                               BT_GATT_PERM_READ,
//                                               NULL, NULL, json_payload_cache), // mettre ici l'addresse de la valeur qu'on veut envoyer

//                        /* Descripteur CCC (Contrôlé par l'application mobile) */
//                        BT_GATT_CCC(my_ccc_cfg_changed, BT_GATT_PERM_READ | BT_GATT_PERM_WRITE), );

// /* Fonction publique d'envoi (appelée par main.c) */
// // int my_service_send_adc_value(uint16_t value)
// // {
// //     // Met à jour la valeur du cache
// //     adc_value_cache = value;

// //     // Envoie la notification si l'abonnement est actif.
// //     // On cible la Déclaration de la Caractéristique (Index 1)
// //     return bt_gatt_notify(NULL, &my_service.attrs[1], &value, sizeof(value));
// // }

// int my_service_send_json(const char *data, uint16_t len)
// {
//     // Sécurité : ne pas déborder du cache
//     if (len > sizeof(json_payload_cache))
//     {
//         LOG_ERR("JSON trop grand pour le buffer !");
//         return -1;
//     }

//     // Copie dans le cache local (pour permettre la lecture 'READ')
//     memcpy(json_payload_cache, data, len);

//     // Envoi de la notification
//     // Note : attrs[1] est toujours la déclaration, attrs[2] la valeur si on compte implicitement
//     // Mais le plus sûr est souvent d'utiliser l'attribut directement si accessible,
//     // ou de garder l'index 1 si votre définition est standard. Ici index 1 pointe vers la Value attribute.
//     return bt_gatt_notify(NULL, &my_service.attrs[2], data, len);
// }


#include <zephyr/bluetooth/bluetooth.h>
#include <zephyr/bluetooth/gatt.h>
#include <zephyr/bluetooth/uuid.h>
#include <zephyr/logging/log.h>
#include <string.h> // Nécessaire pour memset et memcpy

#include "my_service.h"

LOG_MODULE_REGISTER(my_service_module);

static struct bt_uuid_128 service_uuid = BT_UUID_INIT_128(MY_SERVICE_UUID);
static struct bt_uuid_128 char_uuid = BT_UUID_INIT_128(MY_CHARACTERISTIC_UUID);

/* * Cache local : C'est ici que les "déchets" survivent si on ne nettoie pas.
 * On prévoit large (128 ou 247 octets) pour supporter le MTU max.
 */
static char json_payload_cache[247]; 

static void my_ccc_cfg_changed(const struct bt_gatt_attr *attr, uint16_t value) {
    LOG_INF("Notifications changees: %d", (value == BT_GATT_CCC_NOTIFY));
}

BT_GATT_SERVICE_DEFINE(my_service,
    BT_GATT_PRIMARY_SERVICE(&service_uuid),
    
    /* Caractéristique */
    BT_GATT_CHARACTERISTIC(&char_uuid.uuid,
                           BT_GATT_CHRC_READ | BT_GATT_CHRC_NOTIFY,
                           BT_GATT_PERM_READ,
                           NULL, NULL, json_payload_cache),
                           
    /* CCCD */
    BT_GATT_CCC(my_ccc_cfg_changed, BT_GATT_PERM_READ | BT_GATT_PERM_WRITE),
);

/* Fonction d'envoi */
int my_service_send_json(const char *data, uint16_t len) 
{
    // Sécurité : On vérifie qu'on ne dépasse pas la taille du cache
    if (len > sizeof(json_payload_cache)) {
        LOG_ERR("Erreur: Donnee trop grande pour le cache BLE (%d > %d)", len, sizeof(json_payload_cache));
        return -1;
    }

    /* * CORRECTION 1 : Nettoyage du cache INTERNE du service
     * Même si le main est propre, si ce cache est sale, une "lecture" (Read) donnera des déchets.
     */
    memset(json_payload_cache, 0, sizeof(json_payload_cache));

    /* Copie de la donnée propre dans le cache */
    memcpy(json_payload_cache, data, len);

    /* * CORRECTION 2 : L'envoi de la Notification
     * On utilise 'len' (la longueur réelle du texte) et NON 'sizeof' (la taille totale du tableau).
     * On pointe sur attrs[2] (la Valeur).
     */
    return bt_gatt_notify(NULL, &my_service.attrs[2], json_payload_cache, len);
}
```

## src/my_service.h
```c
#ifndef MY_SERVICE_H
#define MY_SERVICE_H

#include <zephyr/types.h>

/* UUIDs du Service Périphérique (Tu peux les changer si nécessaire) */
#define MY_SERVICE_UUID      0xd4, 0x86, 0x48, 0x24, 0x54, 0xb3, 0x43, 0xa1, \
                             0xbc, 0x20, 0x97, 0x8f, 0xc3, 0x76, 0xc2, 0x75
#define MY_CHARACTERISTIC_UUID 0xd4, 0x86, 0x48, 0x24, 0x54, 0xb3, 0x43, 0xa1, \
                             0xbc, 0x20, 0x97, 0x8f, 0xc3, 0x76, 0xc2, 0x76
#define MY_TARGET_UUID 0xd4, 0x86, 0x48, 0x24, 0x54, 0xb3, 0x43, 0xa1, \
                        0xbc, 0x20, 0x97, 0x8f, 0xc3, 0x76, 0xc2, 0x78 

/* Fonction publique pour envoyer la donnée ADC (appelée depuis main.c) */
//int my_service_send_adc_value(uint16_t value);
int my_service_send_json(const char *data, uint16_t len);

#endif
```
